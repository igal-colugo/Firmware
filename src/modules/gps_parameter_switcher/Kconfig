## src/modules/gps_parameter_switcher/Kconfig
```kconfig
menuconfig MODULES_GPS_PARAMETER_SWITCHER
	bool "gps_parameter_switcher"
	default n
	---help---
		Enable support for gps_parameter_switcher

menuconfig USER_GPS_PARAMETER_SWITCHER
	bool "gps_parameter_switcher running as userspace module"
	default y
	depends on BOARD_PROTECTED && MODULES_GPS_PARAMETER_SWITCHER
	---help---
		Put gps_parameter_switcher in userspace memory
```
