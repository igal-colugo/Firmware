## src/drivers/currawong/Kconfig
```kconfig
menu "Currawong"
    menuconfig COMMON_CURRAWONG
        bool "Common currawong"
        default n
        select DRIVERS_CURRAWONG_CE367ECU
        ---help---
            Enable default set of currawong drivers

    rsource "*/Kconfig"
endmenu
```

## src/drivers/currawong/ce367ecu/Kconfig
```kconfig
menuconfig DRIVERS_CURRAWONG_CE367ECU
	bool "ce367ecu"
	default n
	---help---
		Enable support for viewpro
```

## src/drivers/gimbal/Kconfig
```kconfig
menu "Gimbal"
    menuconfig COMMON_GIMBAL
        bool "Common gimbal's"
        default n
        select DRIVERS_GIMBAL_VIEWPRO
        ---help---
            Enable default set of gimbal drivers

    rsource "*/Kconfig"
endmenu
```

## src/drivers/gimbal/viewpro/Kconfig
```kconfig
menuconfig DRIVERS_GIMBAL_VIEWPRO
	bool "viewpro"
	default n
	---help---
		Enable support for viewpro
```

## src/drivers/hfe/Kconfig
```kconfig
menu "HFE"
    menuconfig COMMON_HFE
        bool "Common hfe"
        default n
        select DRIVERS_HFE_DA35EFI
        ---help---
            Enable default set of hfe drivers

    rsource "*/Kconfig"
endmenu
```

## src/drivers/hfe/da35efi/Kconfig
```kconfig
menuconfig DRIVERS_HFE_DA35EFI
	bool "da35efi"
	default n
	---help---
		Enable support for hfe engine
```

## src/modules/colugo_failsafe/Kconfig
```kconfig
menuconfig MODULES_COLUGO_FAILSAFE
bool "colugo_failsafe_module"
 default n
 -- - help-- -
 Enable PX4 Colugo failsafe module
```
